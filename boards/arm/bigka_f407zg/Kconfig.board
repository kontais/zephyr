## boards/arm/bigka_f407zg/Kconfig.board
```kconfig
# Kconfig - NUCLEO-64 F401RE board configuration
#
# Copyright (c) 2016 Linaro Limited.
#
# SPDX-License-Identifier: Apache-2.0
#

config BOARD_BIGKA_F407ZG
	bool "BOARD_BIGKA_F407ZG Development Board"
	depends on SOC_STM32F407XG
```

## boards/arm/bigka_f407zg/Kconfig.defconfig
```kconfig
# Kconfig - NUCLEO-64 F401RE board configuration
#
# Copyright (c) 2016 Linaro Limited.
#
# SPDX-License-Identifier: Apache-2.0
#

if BOARD_BIGKA_F407ZG

config BOARD
	default bigka_f407zg

endif # BOARD_BIGKA_F407ZG
```

## boards/arm/moba_f407vg/Kconfig.board
```kconfig
# Kconfig - NUCLEO-64 F401RE board configuration
#
# Copyright (c) 2016 Linaro Limited.
#
# SPDX-License-Identifier: Apache-2.0
#

config BOARD_MOBA_F407VG
	bool "BOARD_MOBA_F407VG Development Board"
	depends on SOC_STM32F407XG
```

## boards/arm/moba_f407vg/Kconfig.defconfig
```kconfig
# Kconfig - NUCLEO-64 F401RE board configuration
#
# Copyright (c) 2016 Linaro Limited.
#
# SPDX-License-Identifier: Apache-2.0
#

if BOARD_MOBA_F407VG

config BOARD
	default moba_f407vg

endif # BOARD_MOBA_F407VG
```

## boards/arm/nrf52_acmemcu/Kconfig
```kconfig
# Kconfig - acmemcu nRF52 board configuration
#
# Copyright (c) 2016 Nordic Semiconductor ASA
#
# SPDX-License-Identifier: Apache-2.0

if BOARD_NRF52_ACMEMCU

config  GPIO_AS_PINRESET
	bool "GPIO as pin reset (reset button)"
	default y

endif # BOARD_NRF52_ACMEMCU
```

## boards/arm/nrf52_acmemcu/Kconfig.defconfig
```kconfig
# Kconfig - acmemcunRF52 board configuration
#
# Copyright (c) 2016 Nordic Semiconductor ASA
#
# SPDX-License-Identifier: Apache-2.0

if BOARD_NRF52_ACMEMCU

config BOARD
	default nrf52_acmemcu

if GPIO_NRF5

config GPIO_NRF5_P0
	default y

endif # GPIO_NRF5

if UART_NRF5

config UART_NRF5_GPIO_TX_PIN
	default 6

config UART_NRF5_GPIO_RX_PIN
	default 8

config UART_NRF5_GPIO_RTS_PIN
	default 5

config UART_NRF5_GPIO_CTS_PIN
	default 7

endif # UART_NRF5

endif # BOARD_NRF52_ACMEMCU
```

## boards/arm/stm32f1_opendev/Kconfig.board
```kconfig
# Kconfig - STM32F1_OPENDEV board configuration
#
# Copyright (c) 2016 RnDity Sp. z o.o.
#
# SPDX-License-Identifier: Apache-2.0
#

config BOARD_STM32F1_OPENDEV
	bool "STM32F1_OPENDEV Evaluation Board"
	depends on SOC_STM32F103XE
```

## boards/arm/stm32f1_opendev/Kconfig.defconfig
```kconfig
# Kconfig - STM32F1_OPENDEV board configuration
#
# Copyright (c) 2016 RnDity Sp. z o.o.
#
# SPDX-License-Identifier: Apache-2.0
#

if BOARD_STM32F1_OPENDEV

config BOARD
	default stm32f1_opendev

endif # BOARD_STM32F1_OPENDEV
```

## boards/arm/stm32f1_shenzhou/Kconfig.board
```kconfig
# Kconfig - STM32F1_SHENZHOU board configuration
#
# Copyright (c) 2016 RnDity Sp. z o.o.
#
# SPDX-License-Identifier: Apache-2.0
#

config BOARD_STM32F1_SHENZHOU
	bool "STM32F1_SHENZHOU Evaluation Board"
	depends on SOC_STM32F107XC
```

## boards/arm/stm32f1_shenzhou/Kconfig.defconfig
```kconfig
# Kconfig - STM32F1_SHENZHOU board configuration
#
# Copyright (c) 2016 RnDity Sp. z o.o.
#
# SPDX-License-Identifier: Apache-2.0
#

if BOARD_STM32F1_SHENZHOU

config BOARD
	default stm32f1_shenzhou

endif # BOARD_STM32F1_SHENZHOU
```
