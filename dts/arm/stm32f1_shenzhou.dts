/*
 * Copyright (c) 2017 Linaro Limited
 *
 * SPDX-License-Identifier: Apache-2.0
 */

/dts-v1/;
#include <st/stm32f107.dtsi>

/ {
	model = "STMicroelectronics STM32F1_SHENZHOU board";
	compatible = "st,stm32f1_shenzhou", "st,stm32f107";

	chosen {
		zephyr,console = &usart2;
		zephyr,sram = &sram0;
		zephyr,flash = &flash0;
	};
};

&usart2 {
	current-speed = <115200>;
	status = "ok";
};
