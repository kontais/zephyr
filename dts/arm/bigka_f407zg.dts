/*
 * Copyright (c) 2017 Linaro Limited
 *
 * SPDX-License-Identifier: Apache-2.0
 */

/dts-v1/;
#include <st/stm32f407.dtsi>

/ {
	model = "XCMG STM32F407ZG board";
	compatible = "st,stm32f407zg-bigka", "st,stm32f407";

	chosen {
		zephyr,console = &usart1;
		zephyr,sram = &sram0;
		zephyr,flash = &flash0;
	};
};

&usart1 {
	current-speed = <115200>;
	status = "ok";
};

&usart2 {
	current-speed = <115200>;
	status = "ok";
};
