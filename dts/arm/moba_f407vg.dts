/*
 * Copyright (c) 2017 Linaro Limited
 *
 * SPDX-License-Identifier: Apache-2.0
 */

/dts-v1/;
#include <st/stm32f407.dtsi>

/ {
	model = "XCMG STM32F407VG board";
	compatible = "st,stm32f407vg-moba", "st,stm32f407";

	chosen {
		zephyr,console = &uart4;
		zephyr,sram = &sram0;
		zephyr,flash = &flash0;
	};
};

&uart4 {
	current-speed = <115200>;
	status = "ok";
};
